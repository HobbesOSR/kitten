## arch/arm64/Kconfig
```kconfig
mainmenu "Kitten Kernel Configuration"

config ARM64
	bool
	default y
	help
	  Support for the ARM64 architecture.

config ARM
	bool
	default y

config OUTPUT_FORMAT
        string
        default "elf64-littleaarch64" if ARM64

config BFDARCH
        string
        default "aarch64" if ARM64

source "kernel/Kconfig"

menu "Target Configuration"

choice
	prompt "System Architecture"
	default ARCH_QEMU

config ARCH_STORM_SIM
        bool "STORM Simulator target"
        help
	  Support for STORM simulator.

config ARCH_XGENE
        bool "APM X-GENE"
         help
	  Support for APM X-GENE Systems.

config ARCH_QEMU
    bool "Qemu"
    help
        Support for Qemu ARM V8 platform


config ARCH_RASPI3
	bool "Raspberry Pi 3"
 	help
		Support for Raspberry Pi 3

config ARCH_PINE64
	bool "Pine A64 LTS"
	help
		Support for Pine A64 LTS 

endchoice

choice
	prompt "Processor Family"
	default ARM_V8_3_A

config GENERIC_CPU
	bool "Generic-ARM64 V8"
	help
	  Generic ARM64 V8 CPU.

config ARM_V8_3_A
    bool "ARM V8.3-a"
    help 
        CPU has ARM v8.3-a features


endchoice

choice
	prompt "Timer Interrupt Strategy"
	default TIMER_PERIODIC

config TIMER_PERIODIC
	bool "Periodic timer interrupts"
	help
	  Use a periodic interrupt at SCHED_HZ to drive timer
	  expiration and scheduling in Kitten.

config TIMER_ONESHOT
	bool "One-shot timer interrupts"
	help
	  Uses one-shot timers to drive scheduling in kitten. Results
	  in more accurate scheduling, particularly with EDF scheduling,
	  but can result in higher overheads if fine-grained scheduling
	  or timers are requested.

endchoice



config BLK_DEV_INITRD
       bool "INITRD support"
       help
	"JRL: This is needed if you have an initrd from the bootloader...."

config ARM64_L1_CACHE_BYTES
        int
        default "64" if GENERIC_CPU || ARM_V8_3_A

config ARM64_L1_CACHE_SHIFT
        int
        default "6" if GENERIC_CPU || ARM_V8_3_A

config ARM64_INTERNODE_CACHE_BYTES
	int
	default ARM64_L1_CACHE_BYTES

config ARM64_INTERNODE_CACHE_SHIFT
	int
	default ARM64_L1_CACHE_SHIFT

#
# Define implied options from the CPU selection
#

config SERIAL_PHYS
	hex
	default "0x1C021000" if ARCH_XGENE
	default "0x1C020000" if ARCH_STORM_SIM
    default "0x09000000" if ARCH_QEMU
	default "0x3f215040" if ARCH_RASPI3
	default "0x1c28000"  if ARCH_PINE64
#	default "0x3f201000" if ARCH_RASPI3


config NR_CPUS
        int "Maximum number of CPUs (2-256)"
        range 1 255
        default "64"
        help
          This allows you to specify the maximum number of CPUs which this
          kernel will support. Current maximum is 256. Less depending on 
          the hardware.

          This is purely to save memory - each supported CPU requires
          memory in the static kernel configuration.

#
# Physical address where the kernel is loaded
#
config PHYSICAL_START
	hex
	default "0x200000"

# source user/iofwd/Kconfig

config HAS_IOMEM
	bool
	default "y"

config HAS_IOPORT
	bool
	default "y"

config SMP
	bool
	default "y"

config ACPI
	bool
	default "y"

config ARM_PSCI_FW
	bool
	default "y"

endmenu



menu Virtualization

config HAFNIUM
  bool "Hafnium Hypervisor"
  depends on ARM64
  default n
  help
    Enables the Hafnium Hypervisor extensions

endmenu

source "arch/arm64/boot/Kconfig"
source "arch/arm64/Kconfig.debug"


source "drivers/Kconfig"

# TODO This might be painful later
#source "linux/arch/arm64/Kconfig"
```

## arch/arm64/boot/Kconfig
```kconfig
menu "ISOIMAGE Configuration"
depends on PC

config KERNEL_ARGS
	string "Kernel Command Line Arguments"
	default "console=vga,serial" if !PALACIOS
	default "console=serial" if PALACIOS
	help
	  Arguments to be passed to the kernel.
	  If you are booting a guest OS that may use the VGA
	  console, "console=serial" is suggested.

config INIT_TASK_IMAGE
	string "Initial Task Image"
	default "init_task"
	help
	  Path to the ELF executable or guest OS image to use for the
	  initial task.  Kitten loads this as the first user-level task.
	  It executes with root privilege.

config INIT_TASK_ARGS
	string "Initial Task Arguments"
	default "one two three"
	help
	  Arguments to be passed to the initial task.

config INIT_TASK_ENVS
	string "Initial Task Environment Variables"
	default "one=1 two=2 three=3"
	help
	  Environment to be passed to the initial task.

choice
	prompt "Bootloader"
	default SYSLINUX

config SYSLINUX_BOOTLOADER
	bool "Syslinux"
	help
	  When building the isoimage, use Syslinux as the bootloader.

config GRUB_BOOTLOADER
	bool "GRUB"
	help
	  When building the isoimage, use GRUB or GRUB2 as the bootloader.

endchoice

config GRUB2_MODS
	string "GRUB2 modules to be included"
	depends on GRUB_BOOTLOADER
	default ""

endmenu
```

## arch/x86_64/Kconfig
```kconfig
mainmenu "Kitten Kernel Configuration"

config X86_64
	bool
	default y
	help
	  Support for the x86_64 architecture.

config X86
	bool
	default y

config X86_MCE 
	bool
	default y

config X86_MCE_INJECT
	bool
	default y

config OUTPUT_FORMAT
        string
        default "elf64-k1om" if ARCH = "k1om"
        default "elf64-x86-64" if X86_64

config BFDARCH
        string
        default "k1om" if ARCH = "k1om"
        default "i386" if X86_64

source "kernel/Kconfig"

menu "Target Configuration"

choice
	prompt "System Architecture"
	default PC

config PC
        bool "PC-compatible"
        help
	  Support for standard PC compatible systems.

config CRAY_GEMINI
	bool "Cray XE and XK systems"
	help
	  Support for Cray XE and XK systems.
	  These systems use the Cray Gemini interconnect.

config PISCES
	bool "Multi-instance environment"
	help 
	  Support for running Kitten as a multi-instance enclave

endchoice


choice
	prompt "Processor Family"
	default GENERIC_CPU

config MK8
	bool "AMD-Opteron/Athlon64"
	help
	  Optimize for AMD Opteron/Athlon64/Hammer/K8 CPUs.

config MPSC
	bool "Intel-64/Core2"
	help
	  Optimize for Intel 64 architecture.

config MK1OM
	bool "Intel Knights Corner"
	help
	  Select this for the CPU used in the Intel Many Integrated Core
	  (Intel MIC) products code-named Knights Corner. The CPU is an
	  in-order, 4-way SMT design that is mostly x86-64 compatible
	  but has a different vector unit. The differences from x86-64
	  force incompatible calling conventions, so GCC and binutils
	  assign it a unique ELF machine type: EM_K1OM.

	  Future Intel products will be part of the x86 ecosystem, *not*
	  derivatives of this incompatible offshoot.

config GENERIC_CPU
	bool "Generic-x86-64"
	help
	  Generic x86-64 CPU.

endchoice

choice
	prompt "Timer Interrupt Strategy"
	default TIMER_PERIODIC

config TIMER_PERIODIC
	bool "Periodic timer interrupts"
	help
	  Use a periodic interrupt at SCHED_HZ to drive timer
	  expiration and scheduling in Kitten.

config TIMER_ONESHOT
	bool "One-shot timer interrupts"
	help
	  Uses one-shot timers to drive scheduling in kitten. Results
	  in more accurate scheduling, particularly with EDF scheduling,
	  but can result in higher overheads if fine-grained scheduling
	  or timers are requested.

endchoice

config TASK_MEAS
	bool "Kitten Task Based Power Measurements"
	help
	  Periodic updates of task power and energy used
choice
	prompt "Task Based Power Measurement Method"
	default TASK_MEAS_INTEL_IVY_MSR

config TASK_MEAS_INTEL_SANDY_MSR
	bool "Timer Based Intel Sandy MSR Support"
	depends on TASK_MEAS
	help
	Timer based Intel Sandy MSR task updates

config TASK_MEAS_INTEL_IVY_MSR
	bool "Timer Based Intel Ivy MSR Support"
	depends on TASK_MEAS
	help
	Timer based Intel Ivy MSR task updates

endchoice

config SCHED_EDF
	bool "Kitten Earliest Deadline First (EDF)"
	help
	  A real time EDF scheduler is used.
choice
depends on SCHED_EDF
	prompt "EDF Scheduler version"
	default SCHED_EDF_NWC

config SCHED_EDF_NWC
	bool "Non-Work-Conserving EDF Scheduler"
	depends on SCHED_EDF
	help
	Non-Work-Conserving version of EDF is used

config SCHED_EDF_WC
	bool "Work Conserving EDF Scheduler"
	depends on SCHED_EDF
	help
	Work-Conserving version of EDF is used

config  SCHED_EDF_RR
        bool "NWC EDF + Round Robin when CPU is idle"
	depends on SCHED_EDF
        help
        Round Robin is used after all tasks have consumed their slices within a period.
endchoice

#
# Define implied options from the CPU selection
#

# this should be set for all -march=.. options where the compiler generates cmov.
config X86_CMOV
	def_bool y
	depends on GENERIC_CPU || MK8 || MPSC

# non-X86_64 wierdness on Intel KNC (ARCH=MK1OM)
config X86_EARLYMIC
	def_bool y
	depends on MK1OM

config X86_L1_CACHE_BYTES
        int
        default "128" if MPSC
        default "64" if GENERIC_CPU || MK8 || MK1OM

config X86_L1_CACHE_SHIFT
        int
        default "7" if MPSC
        default "6" if GENERIC_CPU || MK8 || MK1OM

config X86_INTERNODE_CACHE_BYTES
	int
	default X86_L1_CACHE_BYTES

config X86_INTERNODE_CACHE_SHIFT
	int
	default X86_L1_CACHE_SHIFT

config NR_CPUS
        int "Maximum number of CPUs (2-256)"
        range 1 255
        default "64"
        help
          This allows you to specify the maximum number of CPUs which this
          kernel will support. Current maximum is 256 CPUs due to
          APIC addressing limits. Less depending on the hardware.

          This is purely to save memory - each supported CPU requires
          memory in the static kernel configuration.

#
# Physical address where the kernel is loaded
#
config PHYSICAL_START
	hex
	default "0x200000"

endmenu

menu "Virtualization"

config PALACIOS
	bool "Include Palacios virtual machine monitor"
	default "n"
	help
	  Include the Palacios virtual machine monitor. This enables Kitten
	  to run guest operating systems alongside native applications.


choice
	prompt "Internal/External Palacios library"
	depends on PALACIOS
	default PALACIOS_INT

config PALACIOS_INTERNAL
	bool "Link core Palacios library directly to Kitten interfaces"
	help 
		This is the old style linking mechanism that required 
		internalized Palacios interfaces to be implemented 
		inside Kitten

config PALACIOS_EXTERNAL
	bool "Link in Palacios as a self contained module"
	select BLOCK_DEVICE
	help 
		New linking style that modularizes Palacios and requires
		no Palacios interfaces to be included inside Kitten
		
endchoice
 

config PALACIOS_SOCKET
        bool
        depends on NETWORK && LWIP_TCP && LWIP_UDP && LWIP_SOCKET && PALACIOS_INTERNAL
        default "y"

config PALACIOS_GDB
	bool
	depends on PALACIOS && PALACIOS_INTERNAL
	default "y"

config PALACIOS_PATH
	string "Path to pre-built Palacios tree"
	depends on PALACIOS
	default "../palacios"
	help
	  Path to a built Palacios source tree. This path is used to
	  find Palacios include files and libraries that need to be
	  linked with the Kitten kernel image.


config BUILT_IN_GUEST_OS
	depends on PALACIOS
	bool "Compile Guest OS image into Kitten init_task"
	

config GUEST_OS_ISOIMAGE_PATH
	string "Path to guest OS image"
	depends on BUILT_IN_GUEST_OS
	default "../guest_os/linux_guest.img"
	help
	  Path to a guest image to link with the example user/hello_world
	  init task.  The hello_world init task will use this image
	  to spawn a guest OS virtual machine via Palacios.  The guest
          image must be built with the build_vm tool included with
          the Palacios source code (in palacios/utils/guest_creator).

endmenu

# source user/iofwd/Kconfig

config HAS_IOMEM
	bool
	default "y"

config HAS_IOPORT
	bool
	default "y"

config SMP
	bool
	default "y"

config ACPI
	bool
	default "y"

source "net/Kconfig"
source "block/Kconfig"
source "drivers/Kconfig"
source "arch/x86_64/boot/Kconfig"
source "arch/x86_64/Kconfig.debug"
#source "linux/arch/x86_64/Kconfig"
source "ofed/Kconfig"
```

## arch/x86_64/boot/Kconfig
```kconfig
menu "ISOIMAGE Configuration"
depends on PC

config KERNEL_ARGS
	string "Kernel Command Line Arguments"
	default "console=vga,serial" if !PALACIOS
	default "console=serial" if PALACIOS
	help
	  Arguments to be passed to the kernel.
	  If you are booting a guest OS that may use the VGA
	  console, "console=serial" is suggested.

config INIT_TASK_IMAGE
	string "Initial Task Image"
	default "init_task"
	help
	  Path to the ELF executable or guest OS image to use for the
	  initial task.  Kitten loads this as the first user-level task.
	  It executes with root privilege.

config INIT_TASK_ARGS
	string "Initial Task Arguments"
	default "one two three"
	help
	  Arguments to be passed to the initial task.

config INIT_TASK_ENVS
	string "Initial Task Environment Variables"
	default "one=1 two=2 three=3"
	help
	  Environment to be passed to the initial task.

endmenu
```

## block/Kconfig
```kconfig
menu "Block Device"

config BLOCK_DEVICE
        bool "Enable Block driver support"
        default n

endmenu
```

## drivers/Kconfig
```kconfig
menu "Device drivers"

#
# Device Drivers
#
config VGA_CONSOLE
	bool "VGA console"
	depends on PC
	default PC

config SERIAL_CONSOLE
	bool "Serial console support"
	depends on PC || CRAY_GEMINI
	default y

config VM_CONSOLE
	bool "VM console"
	depends on PC
	default PC
	help
	  Paravirtualized console device driver for use by guest
	  virtual machines.
	  If the kernel will be run under Palacios, say yes.

config KEYBOARD
	bool
	depends on PC && !PALACIOS
	default PC

config DEVFS
	bool
	default y

config E1000
        bool "E1000 Device Driver (e1000)"
        depends on NETWORK && LWIP_ARP
        default PC

config NE2K
        bool "NE2K Device Driver (rtl8139)"
        depends on NETWORK && LWIP_ARP
        default PC

config GIGE
        bool "GigE Device Driver (r8169)"
        depends on NETWORK && LWIP_ARP
        default PC

config VMNET
        bool "VM Network Driver"
        depends on NETWORK && LWIP_ARP
        default PC
        help
          Paravirtualized network device driver for use by guest
          virtual machines.
          If the kernel will be run under Palacios, say yes.

config CRAY_GEMINI_NET
	bool "Cray Gemini Network (gemini)"
	depends on CRAY_GEMINI
	default y

config SATA
	bool "SATA block driver"
	depends on BLOCK_DEVICE
	default PC
	help 
	  SATA compatible block driver for raw disk access


config XPMEM
        bool "XPMEM driver"
	default PISCES
	help
	  XPMEM driver

choice
        prompt "XPMEM name/forwarding service"
        depends on XPMEM
        default XPMEM_FWD

config XPMEM_NS
        bool "The XPMEM name service"
        help 
	        Select this if you want to run the XPMEM name service

config XPMEM_FWD
        bool "The XPMEM forwarding service"
        help 
	        Select this if you want to run the XPMEM forwarding service
    
endchoice


config RCR
	bool "RCR driver"
	default n
	help
		Resource Centric Reflection driver.
		If this driver is enabled, a kernel thread will be created
		that periodically reads a set of performance counters and
		publishes them to a 'blackboard' region of memory that can
		be mapped into a user-space process via /dev/msr.

endmenu
```

## drivers/acpi/Kconfig.debug
```kconfig
if ACPI

# This macro is observed in drivers/acpi/Makefile and translated to a
# compile-time MACRO definition that enables or disables debug print statements
# within the code.
config ACPI_DEBUG
	bool "ACPI Debugging (NOT YET FUNCTIONAL)"
	default n
	help
		Enable debug print statements from the ACPI system.

		This option NOT yet functioning. utglobal.c needs to be
		'imported' from Linux source code to resolve linker errors.

config ACPI_DEBUG_FUNC_TRACE
	bool "ACPI Function call tracing (NOT YET FUNCTIONAL)"
	default n
	depends on ACPI_DEBUG
	help
		Enable debug print statements of the call flow within ACPI.

		This option NOT yet functioning. utglobal.c needs to be
		'imported' from Linux source code to resolve linker errors.

endif	# ACPI
```
