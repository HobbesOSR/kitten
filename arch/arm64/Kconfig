## ofed/drivers/infiniband/Kconfig
```kconfig
config INFINIBAND
	bool "InfiniBand support"
	---help---
	  Core support for InfiniBand (IB).  Make sure to also select
	  any protocols you wish to use as well as drivers for your
	  InfiniBand hardware.


config INFINIBAND_USER_MAD
	bool "InfiniBand userspace MAD support"
	depends on INFINIBAND
	---help---
	  Userspace InfiniBand Management Datagram (MAD) support.  This
	  is the kernel side of the userspace MAD support, which allows
	  userspace processes to send and receive MADs. You will also
	  need libibumad from <http://www.openib.org>.

config INFINIBAND_USER_ACCESS
	bool "InfiniBand userspace access (verbs and CM)"
	---help---
	  Userspace InfiniBand access support.  This enables the
	  kernel side of userspace verbs and the userspace
	  communication manager (CM).  This allows userspace processes
	  to set up connections and directly access InfiniBand
	  hardware for fast-path operations.  You will also need
	  libibverbs, libibcm and a hardware driver library from
	  <http://www.openib.org>.

config INFINIBAND_USER_MEM
	bool
	depends on INFINIBAND_USER_ACCESS
	default y

config INFINIBAND_ADDR_TRANS
	bool
	default y

source "ofed/drivers/infiniband/hw/mthca/Kconfig"
source "ofed/drivers/infiniband/hw/mlx4/Kconfig"

source "ofed/drivers/infiniband/ulp/ipoib/Kconfig"

#source "ofed/drivers/infiniband/ulp/sdp/Kconfig"

source "ofed/drivers/infiniband/util/Kconfig"
```

## ofed/drivers/infiniband/hw/mlx4/Kconfig
```kconfig
config MLX4_INFINIBAND
	bool "Mellanox ConnectX HCA support"
	---help---
	  This driver provides low-level InfiniBand support for
	  Mellanox ConnectX PCI Express host channel adapters (HCAs).
	  This is required to use InfiniBand protocols such as
	  IP-over-IB or SRP with these devices.
```
