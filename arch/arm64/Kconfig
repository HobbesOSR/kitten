## init/Kconfig
```kconfig
config KALLSYMS
	bool
	default "y"
	help
	   Say Y here to let the kernel print out symbolic crash information and
	   symbolic stack backtraces. This increases the size of the kernel
	   somewhat, as all symbols have to be loaded into the kernel image.

config KALLSYSM_ALL
	bool
	default "y"
	help
	   Normally kallsyms only contains the symbols of functions, for nicer
	   OOPS messages.  Some debuggers can use kallsyms for other
	   symbols too: say Y here to include all symbols, if you need them
	   and you don't care about adding to the size of your kernel.
```

## kernel/Kconfig
```kconfig
config KALLSYMS
	bool
	default "y"
	help
	   Say Y here to let the kernel print out symbolic crash information and
	   symbolic stack backtraces. This increases the size of the kernel
	   somewhat, as all symbols have to be loaded into the kernel image.

config KALLSYSM_ALL
	bool
	default "y"
	help
	   Normally kallsyms only contains the symbols of functions, for nicer
	   OOPS messages.  Some debuggers can use kallsyms for other
	   symbols too: say Y here to include all symbols, if you need them
	   and you don't care about adding to the size of your kernel.

config LOCALVERSION_AUTO
	bool
	default "y"
	help
	  Build SCM tag into version string.  Always turned on.

config PCI_DEVICE_DB
	bool
	default "y"
	help
	  Include PCI device database in kernel image.  This is used
	  to convert PCI device IDs to human readable strings.
	  Enabling this option adds about 400 KB to the kernel image.

config HIO_SYSCALL
	bool "Hobbes I/O system call forwarding"
	default "n"
	depends on PISCES || PALACIOS
	help
	  Enables the forwarding of system calls via HIO (Hobbes I/O)

choice
	prompt "HIO forwarding implementation"
	depends on HIO_SYSCALL

config HIO_SYSCALL_USER
	bool "User-level (/dev/hio) forwarding channel"
	depends on HIO_SYSCALL && PALACIOS
	help
		Select this if you want to forward into a user-space process via /dev/hio

config HIO_SYSCALL_PALACIOS
	bool "Palacios virtual forwarding channel"
	depends on HIO_SYSCALL && PALACIOS
	help
		Select this if you want to forward into a Palacios virtual machine

config HIO_SYSCALL_PISCES
	bool "Pisces co-kernel forwarding channel"
	depends on HIO_SYSCALL && PISCES
	help
		Select this if you want to forward into the Linux host kernel

endchoice
```

## lib/Kconfig.debug
```kconfig
config DEBUG_KERNEL
	bool "Kernel debugging"
	help
	  Say Y here if you are developing drivers or trying to debug and
	  identify kernel problems.

config LOG_BUF_SHIFT
	int "Kernel log buffer size (16 => 64KB, 17 => 128KB)" if DEBUG_KERNEL
	range 12 21
	default 15
	help
	  Select kernel log buffer size as a power of 2.
	  Defaults and Examples:
	  	     17 => 128 KB
		     16 => 64 KB
	             15 => 32 KB
	             14 => 16 KB
		     13 =>  8 KB
		     12 =>  4 KB

config DEBUG_MUTEXES
	bool "Mutex debugging, deadlock detection"
	default n
	depends on DEBUG_KERNEL
	help
	 This allows mutex semantics violations and mutex related deadlocks
	 (lockups) to be detected and reported automatically.

config DEBUG_SPINLOCK
	bool "Spinlock debugging"
	depends on DEBUG_KERNEL
	help
	  Say Y here and build SMP to catch missing spinlock initialization
	  and certain other kinds of spinlock errors commonly made.  This is
	  best used in conjunction with the NMI watchdog so that spinlock
	  deadlocks are also debuggable.

config DEBUG_SPINLOCK_SLEEP
	bool "Sleep-inside-spinlock checking"
	depends on DEBUG_KERNEL
	help
	  If you say Y here, various routines which may sleep will become very
	  noisy if they are called with a spinlock held.

config DEBUG_BUGVERBOSE
	bool "Verbose BUG() reporting (adds 70K)" if DEBUG_KERNEL && EMBEDDED
	depends on BUG
	depends on ARM || ARM26 || M32R || M68K || SPARC32 || SPARC64 || X86_32 || FRV
	default !EMBEDDED
	help
	  Say Y here to make BUG() panics output the file name and line number
	  of the BUG call as well as the EIP and oops trace.  This aids
	  debugging but costs about 70-100K of memory.

config DEBUG_INFO
	bool "Compile the kernel with debug info"
	depends on DEBUG_KERNEL
	help
          If you say Y here the resulting kernel image will include
	  debugging info resulting in a larger kernel image.
	  Say Y here only if you plan to debug the kernel.

	  If unsure, say N.

config DEBUG_HW_NOISE
        bool "Measure noise in the underlying hardware/vmm at boot time"
        default "n"
        help
           Measures interruption of the CPU by the underlying
           hardware/bios/virtual machine monitor at boot just after
           initializing core kitten functionality but prior to starting the
           scheduler. The LAPIC timer is disabled during this measurement.
           Has no impact on system performance after final boot. 
	   Say Y here if you need to diagnose or understand performance
	   quirks of the underlying hardware or VMM.

	   If unsure, say N.

config KGDB
        bool "KGDB: kernel debugging with remote gdb"
        select FRAME_POINTER
        depends on DEBUG_KERNEL
        help
          If you say Y here, it will be possible to remotely debug the
          kernel using gdb.  Documentation of kernel debugger is available
          at http://kgdb.sourceforge.net as well as in DocBook form
          in Documentation/DocBook/.  If unsure, say N.

config KGDB_SERIAL_CONSOLE
        tristate "KGDB: use kgdb over the serial console"
        depends on KGDB
        default y
        help
          Share a serial console with kgdb.

config FRAME_POINTER
	bool "Compile the kernel with frame pointers"
	depends on DEBUG_KERNEL
	default y if DEBUG_INFO && UML
	help
	  If you say Y here the resulting kernel image will be slightly larger
	  and slower, but it might give very useful debugging information on
	  some architectures or if you use external debuggers.
	  If you don't debug the kernel, you can say N.

config UNWIND_INFO
	bool "Compile the kernel with frame unwind information"
	depends on !IA64
	depends on !MODULES || !(MIPS || PARISC || PPC || SUPERH || V850)
	help
	  If you say Y here the resulting kernel image will be slightly larger
	  but not slower, and it will give very useful debugging information.
	  If you don't debug the kernel, you can say N, but we may not be able
	  to solve problems without frame unwind information or frame pointers.

config FORCED_INLINING
	bool "Force gcc to inline functions marked 'inline'"
	depends on DEBUG_KERNEL
	default y
	help
	  This option determines if the kernel forces gcc to inline the functions
	  developers have marked 'inline'. Doing so takes away freedom from gcc to
	  do what it thinks is best, which is desirable for the gcc 3.x series of
	  compilers. The gcc 4.x series have a rewritten inlining algorithm and
	  disabling this option will generate a smaller kernel there. Hopefully
	  this algorithm is so good that allowing gcc4 to make the decision can
	  become the default in the future, until then this option is there to
	  test gcc for this.
```

## linux/Kconfig
```kconfig
config LINUX
	bool "Include Linux compatibility layer"
	default "n"
	help
	  The Linux compatibility layer includes various Linux headers and
	  core code needed to support a (small) subset of Linux device drivers
	  in the LWK.  The list of available Linux drivers will be displayed
	  when this option is enabled.

source "linux/ofed/Kconfig"

config PCI_MSI
	bool
	depends on LINUX
	default "n"
	help
	  Enable the MSI support for Linux compatible components.
          This should be Enabled at all times, but it wasn't initially so I'm leary of just turning it on
	  This should be removed and hardcoded to ON in the near future
		

config SYSFS
	bool
	depends on LINUX
	default "y"
	help
	  Enable the Linux sysfs compatability wrappers.
	  Always on!

config SYSFS_DEPRECATED
	bool
        depends on LINUX
        default "y"
        help
          Enable the Linux sysfs depricated mode.
          Always on!
```

## linux/arch/x86/Kconfig
```kconfig
menu "Linux Compatibility Layer"

source "linux/Kconfig"

config PCI
        bool
        depends on LINUX
        default y
        help
          Include support for PCI devices.

# x86-64 doesn't support PCI BIOS access from long mode so always go direct.
config PCI_DIRECT
        def_bool y
        depends on PCI

source "linux/drivers/pci/Kconfig"
source "linux/drivers/infiniband/Kconfig"

endmenu
```

## linux/arch/x86_64/Kconfig
```kconfig
menu "Linux Compatibility Layer"

source "linux/Kconfig"

config PCI
        bool
        depends on LINUX
        default y
        help
          Include support for PCI devices.



source "linux/drivers/pci/Kconfig"

config X86_IO_APIC
	def_bool y

endmenu
```

## linux/drivers/infiniband/Kconfig
```kconfig
config INFINIBAND
	tristate "InfiniBand support"
	depends on PCI || BROKEN
	depends on HAS_IOMEM
	depends on LINUX
	default y
	---help---
	  Core support for InfiniBand (IB).  Make sure to also select
	  any protocols you wish to use as well as drivers for your
	  InfiniBand hardware.

if INFINIBAND

config INFINIBAND_USER_MAD
	tristate "InfiniBand userspace MAD support"
	depends on INFINIBAND
	---help---
	  Userspace InfiniBand Management Datagram (MAD) support.  This
	  is the kernel side of the userspace MAD support, which allows
	  userspace processes to send and receive MADs. You will also
	  need libibumad from <http://www.openib.org>.

config INFINIBAND_USER_ACCESS
	tristate "InfiniBand userspace access (verbs and CM)"
	---help---
	  Userspace InfiniBand access support.  This enables the
	  kernel side of userspace verbs and the userspace
	  communication manager (CM).  This allows userspace processes
	  to set up connections and directly access InfiniBand
	  hardware for fast-path operations.  You will also need
	  libibverbs, libibcm and a hardware driver library from
	  <http://www.openib.org>.

config INFINIBAND_USER_MEM
	bool
	depends on INFINIBAND_USER_ACCESS != n
	default y

config INFINIBAND_ADDR_TRANS
	bool
	depends on INET
	default y

source "linux/drivers/infiniband/hw/mthca/Kconfig"
source "linux/drivers/infiniband/hw/mlx4/Kconfig"

endif # INFINIBAND
```

## linux/drivers/infiniband/hw/mlx4/Kconfig
```kconfig
config INFINIBAND_MLX4
	bool "Mellanox ConnectX HCA support"
	default y
	select MLX4_CORE
	---help---
	  This driver provides low-level InfiniBand support for
	  Mellanox ConnectX PCI Express host channel adapters (HCAs).

config MLX4_CORE
	bool
	depends on MLX4_INFINIBAND
	default y

config MLX4_DEBUG
	bool
	depends on MLX4_CORE
	default y
```

## linux/drivers/pci/Kconfig
```kconfig
config PCI
	bool
	depends on LINUX
	default y
	help
	  Include support for PCI devices.

if PCI

config ARCH_SUPPORTS_MSI
	bool
	default n

config PCI_MSI
	bool "Message Signaled Interrupts (MSI and MSI-X)"
	depends on ARCH_SUPPORTS_MSI
	help
	   This allows device drivers to enable MSI (Message Signaled
	   Interrupts).  Message Signaled Interrupts enable a device to
	   generate an interrupt using an inbound Memory Write on its
	   PCI bus instead of asserting a device IRQ pin.

	   Use of PCI MSI interrupts can be disabled at kernel boot time
	   by using the 'pci=nomsi' option.  This disables MSI for the
	   entire system.

	   If you don't know what to do here, say N.

config PCI_LEGACY
	bool
	default y
	help
	  Say Y here if you want to include support for the deprecated
	  pci_find_slot() and pci_find_device() APIs.  Most drivers have
	  been converted over to using the proper hotplug APIs, so this
	  option serves to include/exclude only a few drivers that are
	  still using this API.

config PCI_DEBUG
	bool "PCI Debugging"
	depends on DEBUG_KERNEL
	default n
	help
	  Say Y here if you want the PCI core to produce a bunch of debug
	  messages to the system log.  Select this if you are having a
	  problem with PCI support and want to see more of what is going on.

	  When in doubt, say N.

config PCI_DOMAINS
	bool
	default y

endif
```

## linux/ofed/Kconfig
```kconfig
config INFINIBAND
	tristate "InfiniBand support"
	depends on PCI || BROKEN
	depends on HAS_IOMEM
	depends on LINUX
	default y
	---help---
	  Core support for InfiniBand (IB).  Make sure to also select
	  any protocols you wish to use as well as drivers for your
	  InfiniBand hardware.

if INFINIBAND

choice
	prompt "OFED Version"
        default OFED_1_4_1

config OFED_1_4_1
	bool "OFED 1.4.1"

config OFED_1_4_2
	bool "OFED 1.4.2"

config OFED_1_5_1
	bool "OFED 1.5.1"

config OFED_1_5_3
	bool "OFED 1.5.3"

endchoice

config INFINIBAND_USER_MAD
	tristate "InfiniBand userspace MAD support"
	depends on INFINIBAND
	---help---
	  Userspace InfiniBand Management Datagram (MAD) support.  This
	  is the kernel side of the userspace MAD support, which allows
	  userspace processes to send and receive MADs. You will also
	  need libibumad from <http://www.openib.org>.

config INFINIBAND_USER_ACCESS
	tristate "InfiniBand userspace access (verbs and CM)"
	---help---
	  Userspace InfiniBand access support.  This enables the
	  kernel side of userspace verbs and the userspace
	  communication manager (CM).  This allows userspace processes
	  to set up connections and directly access InfiniBand
	  hardware for fast-path operations.  You will also need
	  libibverbs, libibcm and a hardware driver library from
	  <http://www.openib.org>.

config INFINIBAND_USER_MEM
	bool
	depends on INFINIBAND_USER_ACCESS != n
	default y

config INFINIBAND_ADDR_TRANS
    tristate "InfiniBand address translation"
	depends on INFINIBAND
	default y

config IB_IP
	bool "Infiniband IP description"
	default y

if OFED_1_4_1
source linux/ofed/1.4.1/drivers/infiniband/hw/mthca/Kconfig
source linux/ofed/1.4.1/drivers/infiniband/hw/mlx4/Kconfig
config OFED
	string
	default "1.4.1"
endif

if OFED_1_4_2
source linux/ofed/1.4.2/drivers/infiniband/hw/mthca/Kconfig
source linux/ofed/1.4.2/drivers/infiniband/hw/mlx4/Kconfig
config OFED
	string
	default "1.4.2"
endif

if OFED_1_5_1
config 64BIT
	bool
	default y
source linux/ofed/1.5.1/drivers/infiniband/hw/mthca/Kconfig
source linux/ofed/1.5.1/drivers/infiniband/hw/mlx4/Kconfig
source linux/ofed/1.5.1/drivers/infiniband/hw/qib/Kconfig
config OFED
	string
	default "1.5.1"
endif

if OFED_1_5_3
config 64BIT
	bool
	default y
source linux/ofed/1.5.3/drivers/infiniband/hw/mthca/Kconfig
source linux/ofed/1.5.3/drivers/infiniband/hw/mlx4/Kconfig
source linux/ofed/1.5.3/drivers/infiniband/hw/qib/Kconfig
config OFED
	string
	default "1.5.3"
endif


config MLX4_CORE
        bool 
        depends on MLX4_INFINIBAND
        default y

config MLX4_DEBUG
        bool "MLX4 debug"
        depends on MLX4_CORE
        default n


endif # INFINIBAND
```

## net/Kconfig
```kconfig
menu "Networking"

config NETWORK
	bool "Enable lwIP TCP/IP stack"
	default n

config LWIP_TCP
	bool
	depends on NETWORK
	default y
	help
	  Enable TCP support

config LWIP_UDP
	bool
	depends on NETWORK
	default y
	help
	  Enable UDP support

config LWIP_SOCKET
	bool
	depends on NETWORK
	default y
	help
	  Allows threads to open sockets with the POSIX calls.

config LWIP_ARP
 	bool
 	depends on NETWORK
 	default y
	help
	  Enables address resolution protocol

config LWIP_DHCP
 	bool
 	depends on NETWORK
 	default y
 
# config LWIP_DNS
# 	bool "Enable DNS"
# 	depends on NETWORK
# 	default N
# 

endmenu
```

## ofed/Kconfig
```kconfig
menu "OFED"

config OFED
        bool "OFED Driver support"
        ---help---
          This compiles the OFED driver stack

config OFED_COMPAT
        bool "OFED Compatibility Layer"
        ---help---
          This compiles the compatibility layer files without the infiniband drivers


#source "ofed/drivers/infiniband/Kconfig"

endmenu
```
